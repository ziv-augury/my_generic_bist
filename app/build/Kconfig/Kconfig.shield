## app/build/Kconfig/Kconfig.shield
```kconfig
osource "/home/zhershkovitch/workspace/my_bist_example/boards/shields/*/Kconfig.shield"
osource "/home/zhershkovitch/workspace/ncs/nrf/boards/shields/*/Kconfig.shield"
```

## app/build_1/Kconfig/Kconfig.modules
```kconfig
menu "nrf (/home/ziv/workspace/ncs/nrf)"
osource "/home/ziv/workspace/ncs/nrf/Kconfig.nrf"
config ZEPHYR_NRF_MODULE
	bool
	default y
endmenu
menu "hostap (/home/ziv/workspace/ncs/modules/lib/hostap)"
osource "/home/ziv/workspace/ncs/modules/lib/hostap/zephyr/Kconfig"
config ZEPHYR_HOSTAP_MODULE
	bool
	default y
endmenu
menu "mcuboot (/home/ziv/workspace/ncs/bootloader/mcuboot)"
osource "$(ZEPHYR_MCUBOOT_KCONFIG)"
config ZEPHYR_MCUBOOT_MODULE
	bool
	default y
endmenu
menu "mbedtls (/home/ziv/workspace/ncs/modules/crypto/mbedtls)"
osource "$(ZEPHYR_MBEDTLS_KCONFIG)"
config ZEPHYR_MBEDTLS_MODULE
	bool
	default y
endmenu
menu "trusted-firmware-m (/home/ziv/workspace/ncs/modules/tee/tf-m/trusted-firmware-m)"
osource "$(ZEPHYR_TRUSTED_FIRMWARE_M_KCONFIG)"
config ZEPHYR_TRUSTED_FIRMWARE_M_MODULE
	bool
	default y
endmenu
menu "cjson (/home/ziv/workspace/ncs/modules/lib/cjson)"
osource "$(ZEPHYR_CJSON_KCONFIG)"
config ZEPHYR_CJSON_MODULE
	bool
	default y
endmenu
menu "azure-sdk-for-c (/home/ziv/workspace/ncs/modules/lib/azure-sdk-for-c)"
osource "$(ZEPHYR_AZURE_SDK_FOR_C_KCONFIG)"
config ZEPHYR_AZURE_SDK_FOR_C_MODULE
	bool
	default y
endmenu
menu "memfault-firmware-sdk (/home/ziv/workspace/ncs/modules/lib/memfault-firmware-sdk)"
osource "/home/ziv/workspace/ncs/modules/lib/memfault-firmware-sdk/ports/zephyr/Kconfig"
config ZEPHYR_MEMFAULT_FIRMWARE_SDK_MODULE
	bool
	default y
endmenu
menu "cirrus-logic (/home/ziv/workspace/ncs/modules/hal/cirrus-logic)"
osource "/home/ziv/workspace/ncs/modules/hal/cirrus-logic/Kconfig"
config ZEPHYR_CIRRUS_LOGIC_MODULE
	bool
	default y
endmenu
menu "openthread (/home/ziv/workspace/ncs/modules/lib/openthread)"
osource "$(ZEPHYR_OPENTHREAD_KCONFIG)"
config ZEPHYR_OPENTHREAD_MODULE
	bool
	default y
endmenu
menu "canopennode (/home/ziv/workspace/ncs/modules/lib/canopennode)"
osource "$(ZEPHYR_CANOPENNODE_KCONFIG)"
config ZEPHYR_CANOPENNODE_MODULE
	bool
	default y
endmenu
menu "chre (/home/ziv/workspace/ncs/modules/lib/chre)"
osource "/home/ziv/workspace/ncs/modules/lib/chre/platform/zephyr/Kconfig"
config ZEPHYR_CHRE_MODULE
	bool
	default y
endmenu
menu "hal_nordic (/home/ziv/workspace/ncs/modules/hal/nordic)"
osource "$(ZEPHYR_HAL_NORDIC_KCONFIG)"
config ZEPHYR_HAL_NORDIC_MODULE
	bool
	default y
endmenu
menu "liblc3 (/home/ziv/workspace/ncs/modules/lib/liblc3)"
osource "$(ZEPHYR_LIBLC3_KCONFIG)"
config ZEPHYR_LIBLC3_MODULE
	bool
	default y
endmenu
menu "littlefs (/home/ziv/workspace/ncs/modules/fs/littlefs)"
osource "$(ZEPHYR_LITTLEFS_KCONFIG)"
config ZEPHYR_LITTLEFS_MODULE
	bool
	default y
endmenu
menu "loramac-node (/home/ziv/workspace/ncs/modules/lib/loramac-node)"
osource "$(ZEPHYR_LORAMAC_NODE_KCONFIG)"
config ZEPHYR_LORAMAC_NODE_MODULE
	bool
	default y
endmenu
menu "lvgl (/home/ziv/workspace/ncs/modules/lib/gui/lvgl)"
osource "/home/ziv/workspace/ncs/modules/lib/gui/lvgl/zephyr/Kconfig"
config ZEPHYR_LVGL_MODULE
	bool
	default y
endmenu
menu "lz4 (/home/ziv/workspace/ncs/modules/lib/lz4)"
osource "$(ZEPHYR_LZ4_KCONFIG)"
config ZEPHYR_LZ4_MODULE
	bool
	default y
endmenu
menu "nanopb (/home/ziv/workspace/ncs/modules/lib/nanopb)"
osource "$(ZEPHYR_NANOPB_KCONFIG)"
config ZEPHYR_NANOPB_MODULE
	bool
	default y
endmenu
menu "picolibc (/home/ziv/workspace/ncs/modules/lib/picolibc)"
osource "/home/ziv/workspace/ncs/modules/lib/picolibc/zephyr/Kconfig"
config ZEPHYR_PICOLIBC_MODULE
	bool
	default y
endmenu
menu "TraceRecorder (/home/ziv/workspace/ncs/modules/debug/TraceRecorder)"
osource "/home/ziv/workspace/ncs/modules/debug/TraceRecorder/kernelports/Zephyr/Kconfig"
config ZEPHYR_TRACERECORDER_MODULE
	bool
	default y
endmenu
menu "uoscore-uedhoc (/home/ziv/workspace/ncs/modules/lib/uoscore-uedhoc)"
osource "$(ZEPHYR_UOSCORE_UEDHOC_KCONFIG)"
config ZEPHYR_UOSCORE_UEDHOC_MODULE
	bool
	default y
endmenu
menu "zcbor (/home/ziv/workspace/ncs/modules/lib/zcbor)"
osource "$(ZEPHYR_ZCBOR_KCONFIG)"
config ZEPHYR_ZCBOR_MODULE
	bool
	default y
endmenu
menu "zscilib (/home/ziv/workspace/ncs/modules/lib/zscilib)"
osource "/home/ziv/workspace/ncs/modules/lib/zscilib/Kconfig.zscilib"
config ZEPHYR_ZSCILIB_MODULE
	bool
	default y
endmenu
menu "sen1 (/home/ziv/workspace/my_generic_bist/app/../drivers/sensor/sen1)"
osource "/home/ziv/workspace/my_generic_bist/drivers/sensor/sen1/zephyr/Kconfig"
config ZEPHYR_SEN1_MODULE
	bool
	default y
endmenu
menu "sen2 (/home/ziv/workspace/my_generic_bist/app/../drivers/sensor/sen2)"
osource "/home/ziv/workspace/my_generic_bist/drivers/sensor/sen2/zephyr/Kconfig"
config ZEPHYR_SEN2_MODULE
	bool
	default y
endmenu
menu "nrfxlib (/home/ziv/workspace/ncs/nrfxlib)"
osource "/home/ziv/workspace/ncs/nrfxlib/Kconfig.nrfxlib"
config ZEPHYR_NRFXLIB_MODULE
	bool
	default y
endmenu
menu "connectedhomeip (/home/ziv/workspace/ncs/modules/lib/matter)"
osource "/home/ziv/workspace/ncs/modules/lib/matter/config/nrfconnect/chip-module/Kconfig"
config ZEPHYR_CONNECTEDHOMEIP_MODULE
	bool
	default y
endmenu
```

## app/build_1/Kconfig/Kconfig.shield
```kconfig
osource "/home/ziv/workspace/my_generic_bist/boards/shields/*/Kconfig.shield"
osource "/home/ziv/workspace/ncs/nrf/boards/shields/*/Kconfig.shield"
```

## app/build_1_debug/Kconfig/Kconfig.modules
```kconfig
menu "nrf (/home/zhershkovitch/workspace/ncs/nrf)"
osource "/home/zhershkovitch/workspace/ncs/nrf/Kconfig.nrf"
config ZEPHYR_NRF_MODULE
	bool
	default y
endmenu
menu "mcuboot (/home/zhershkovitch/workspace/ncs/bootloader/mcuboot)"
osource "$(ZEPHYR_MCUBOOT_KCONFIG)"
config ZEPHYR_MCUBOOT_MODULE
	bool
	default y
endmenu
menu "mbedtls (/home/zhershkovitch/workspace/ncs/mbedtls)"
osource "$(ZEPHYR_MBEDTLS_KCONFIG)"
config ZEPHYR_MBEDTLS_MODULE
	bool
	default y
endmenu
menu "trusted-firmware-m (/home/zhershkovitch/workspace/ncs/modules/tee/tf-m/trusted-firmware-m)"
osource "$(ZEPHYR_TRUSTED_FIRMWARE_M_KCONFIG)"
config ZEPHYR_TRUSTED_FIRMWARE_M_MODULE
	bool
	default y
endmenu
menu "cjson (/home/zhershkovitch/workspace/ncs/modules/lib/cjson)"
osource "$(ZEPHYR_CJSON_KCONFIG)"
config ZEPHYR_CJSON_MODULE
	bool
	default y
endmenu
menu "cddl-gen (/home/zhershkovitch/workspace/ncs/modules/lib/cddl-gen)"
osource "$(ZEPHYR_CDDL_GEN_KCONFIG)"
config ZEPHYR_CDDL_GEN_MODULE
	bool
	default y
endmenu
menu "memfault-firmware-sdk (/home/zhershkovitch/workspace/ncs/modules/lib/memfault-firmware-sdk)"
osource "/home/zhershkovitch/workspace/ncs/modules/lib/memfault-firmware-sdk/ports/zephyr/Kconfig"
config ZEPHYR_MEMFAULT_FIRMWARE_SDK_MODULE
	bool
	default y
endmenu
menu "CANopenNode (/home/zhershkovitch/workspace/ncs/modules/lib/canopennode)"
osource "$(ZEPHYR_CANOPENNODE_KCONFIG)"
config ZEPHYR_CANOPENNODE_MODULE
	bool
	default y
endmenu
menu "hal_nordic (/home/zhershkovitch/workspace/ncs/modules/hal/nordic)"
osource "$(ZEPHYR_HAL_NORDIC_KCONFIG)"
config ZEPHYR_HAL_NORDIC_MODULE
	bool
	default y
endmenu
menu "loramac-node (/home/zhershkovitch/workspace/ncs/modules/lib/loramac-node)"
osource "$(ZEPHYR_LORAMAC_NODE_KCONFIG)"
config ZEPHYR_LORAMAC_NODE_MODULE
	bool
	default y
endmenu
menu "lz4 (/home/zhershkovitch/workspace/ncs/modules/lib/lz4)"
osource "$(ZEPHYR_LZ4_KCONFIG)"
config ZEPHYR_LZ4_MODULE
	bool
	default y
endmenu
menu "mbedtls (/home/zhershkovitch/workspace/ncs/modules/crypto/mbedtls)"
osource "$(ZEPHYR_MBEDTLS_KCONFIG)"
config ZEPHYR_MBEDTLS_MODULE
	bool
	default y
endmenu
menu "nanopb (/home/zhershkovitch/workspace/ncs/modules/lib/nanopb)"
osource "$(ZEPHYR_NANOPB_KCONFIG)"
config ZEPHYR_NANOPB_MODULE
	bool
	default y
endmenu
menu "TraceRecorder (/home/zhershkovitch/workspace/ncs/modules/debug/TraceRecorder)"
osource "/home/zhershkovitch/workspace/ncs/modules/debug/TraceRecorder/kernelports/Zephyr/Kconfig"
config ZEPHYR_TRACERECORDER_MODULE
	bool
	default y
endmenu
menu "zscilib (/home/zhershkovitch/workspace/ncs/modules/lib/zscilib)"
osource "/home/zhershkovitch/workspace/ncs/modules/lib/zscilib/Kconfig.zscilib"
config ZEPHYR_ZSCILIB_MODULE
	bool
	default y
endmenu
menu "nrfxlib (/home/zhershkovitch/workspace/ncs/nrfxlib)"
osource "/home/zhershkovitch/workspace/ncs/nrfxlib/Kconfig.nrfxlib"
config ZEPHYR_NRFXLIB_MODULE
	bool
	default y
endmenu
menu "connectedhomeip (/home/zhershkovitch/workspace/ncs/modules/lib/matter)"
osource "/home/zhershkovitch/workspace/ncs/modules/lib/matter/config/nrfconnect/chip-module/Kconfig"
config ZEPHYR_CONNECTEDHOMEIP_MODULE
	bool
	default y
endmenu
```

## app/build_1_debug/Kconfig/Kconfig.shield.defconfig
```kconfig
osource "/home/zhershkovitch/workspace/my_bist_example/boards/shields/*/Kconfig.defconfig"
osource "/home/zhershkovitch/workspace/ncs/nrf/boards/shields/*/Kconfig.defconfig"
```

## app/build_board_2/Kconfig/Kconfig.shield.defconfig
```kconfig
osource "/home/ziv/workspace/my_generic_bist/boards/shields/*/Kconfig.defconfig"
osource "/home/ziv/workspace/ncs/nrf/boards/shields/*/Kconfig.defconfig"
```

## boards/arm/my_board_1/Kconfig.board
```kconfig
# Copyright (c) 2022 Nordic Semiconductor ASA
# SPDX-License-Identifier: Apache-2.0

config BOARD_MY_BOARD_1
	bool "my_board_1"
	depends on SOC_NRF52840_QIAA
```

## boards/arm/my_board_1/Kconfig.defconfig
```kconfig
# Copyright (c) 2022 Nordic Semiconductor ASA
# SPDX-License-Identifier: Apache-2.0

if BOARD_MY_BOARD_1

config BOARD
	default "my_board_1"

config BT_CTLR
   default BT

endif
```

## boards/arm/my_board_2/Kconfig.board
```kconfig
# Copyright (c) 2022 Nordic Semiconductor ASA
# SPDX-License-Identifier: Apache-2.0

config BOARD_MY_BOARD_2
	bool "my_board_2"
	depends on SOC_NRF52832_QFAA
```

## boards/arm/my_board_2/Kconfig.defconfig
```kconfig
# Copyright (c) 2022 Nordic Semiconductor ASA
# SPDX-License-Identifier: Apache-2.0

if BOARD_MY_BOARD_2

config BOARD
	default "my_board_2"

config BT_CTLR
   default BT

endif
```

## drivers/drivers_list/zephyr/Kconfig
```kconfig
menuconfig DRIVERS_LIST
    bool "DRIVERS_LIST"
    default n
    help
      enable grouping drivers from dts
```

## drivers/sensor/sen1/zephyr/Kconfig
```kconfig
menuconfig SEN1
	bool "SENSOR1 SPI sensor driver"
	depends on SPI
	help
	  Enable driver for SEN1 sensor driver
```

## drivers/sensor/sen1/zephyr/dts/bindings/sensor/my,sen1.yaml
```yaml
# Copyright (c) 2019 STMicroelectronics
# SPDX-License-Identifier: Apache-2.0

description: |
    my labs, SEN1 device through SPI bus

compatible: "my,sen1"

include: spi-device.yaml

properties:
    bist:
      type: boolean
      required: true
```

## drivers/sensor/sen2/zephyr/Kconfig
```kconfig
menuconfig SEN2
	bool "SENSOR2 SPI sensor driver"
	depends on SPI
	help
	  Enable driver for SEN2 sensor driver
```

## drivers/sensor/sen2/zephyr/dts/bindings/sensor/my,sen2.yaml
```yaml
# Copyright (c) 2019 STMicroelectronics
# SPDX-License-Identifier: Apache-2.0

description: |
    my labs, SEN2 device through SPI bus

compatible: "my,sen2"

include: spi-device.yaml

properties:
    bist:
      type: boolean
      required: true
```

## drivers/sensor/sen3/zephyr/Kconfig
```kconfig
menuconfig SEN3
	bool "SENSOR3 SPI sensor driver"
	depends on SPI
	help
	  Enable driver for SEN3 sensor driver
```

## drivers/sensor/sen3/zephyr/dts/bindings/sensor/my,sen3.yaml
```yaml
# Copyright (c) 2019 STMicroelectronics
# SPDX-License-Identifier: Apache-2.0

description: |
    my labs, SEN3 device through SPI bus

compatible: "my,sen3"

include: spi-device.yaml

properties:
    bist:
      type: boolean
      required: true
```
