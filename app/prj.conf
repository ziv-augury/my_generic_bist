## CMakeLists.txt
```
# SPDX-License-Identifier: Apache-2.0

cmake_minimum_required(VERSION 3.20.0)


if("${BOARD}" MATCHES "my_board_1")
    list(APPEND ZEPHYR_EXTRA_MODULES ${CMAKE_CURRENT_LIST_DIR}/../drivers/sensor/sen1/)
    list(APPEND
        DTS_ROOT
        ${CMAKE_CURRENT_LIST_DIR}/../drivers/sensor/sen1/zephyr/
        )
endif()
      
    list(APPEND ZEPHYR_EXTRA_MODULES ${CMAKE_CURRENT_LIST_DIR}/../drivers/sensor/sen2/)
    list(APPEND
        DTS_ROOT
        ${CMAKE_CURRENT_LIST_DIR}/../drivers/sensor/sen2/zephyr/
        )

if("${BOARD}" MATCHES "my_board_2")
    list(APPEND ZEPHYR_EXTRA_MODULES ${CMAKE_CURRENT_LIST_DIR}/../drivers/sensor/sen3/)
    list(APPEND
        DTS_ROOT
        ${CMAKE_CURRENT_LIST_DIR}/../drivers/sensor/sen3/zephyr/
        )
endif()


find_package(Zephyr REQUIRED HINTS $ENV{ZEPHYR_BASE})
project(my_bist_example)

target_sources(app PRIVATE src/main.c)
target_sources(app PRIVATE src/bist_manager.c)



zephyr_include_directories(${CMAKE_CURRENT_LIST_DIR}/../drivers/include)

# zephyr_library_compile_options(-Werror)
```

## prj.conf
```kconfig
# LOG
CONFIG_LOG=y
CONFIG_LOG_PRINTK=y
# CONFIG_LOG_BACKEND_FORMAT_TIMESTAMP=n

# enable console over SEGGER RTT
CONFIG_CONSOLE=y
CONFIG_USE_SEGGER_RTT=y
CONFIG_RTT_CONSOLE=y

# comms
CONFIG_SPI=y

# sensors
CONFIG_SENSOR=y
```

## my_board_1.conf
```kconfig
CONFIG_SEN1=y
CONFIG_SEN2=y
```

## my_board_2.conf
```kconfig
CONFIG_SEN2=y
CONFIG_SEN3=y
```

## src/main.c
```c
/*
 * Copyright (c) 2012-2014 Wind River Systems, Inc.
 *
 * SPDX-License-Identifier: Apache-2.0
 */

#include <zephyr/kernel.h>
#include <zephyr/sys/printk.h>
#include <my_device.h>
// #include <sys/printk.h>

#include "bist_manager.h"


void main(void)
{
	printk("Hello World! %s\n", CONFIG_BOARD);

	run_all_bists();
	
	k_sleep(K_MSEC(5000));
	printk("done by by");
}
```

## src/bist_manager.c
```c
#include <zephyr/sys/printk.h>

#include <zephyr/devicetree.h>

#include "bist_manager.h"
#include "my_device.h"


#define DEVICE_PTR_IF_NODE_HAS_PROP_BIST_ELSE_NONE(node_id) \
    COND_CODE_1(DT_NODE_HAS_PROP(node_id, bist), \
            (DEVICE_DT_GET(node_id),), ())

const struct device *devs_with_bist_prop[] = {
    DT_FOREACH_NODE(DEVICE_PTR_IF_NODE_HAS_PROP_BIST_ELSE_NONE)
};




void run_all_bists(void)
{
    printk("Enter the Bist!\n");

    for (size_t i = 0; i < ARRAY_SIZE(devs_with_bist_prop); i++) 
    {
        my_bist_run(devs_with_bist_prop[i], NULL);
    }

    printk("done the Bist!\n");

}
```

## src/bist_manager.h
```c
#pragma once


void run_all_bists(void);
```
